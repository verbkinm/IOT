## IOTV/src/MK/FreerRTOS/id_5/ESP32/iotv/main/Kconfig.projbuild
```kconfig
menu "Example Configuration"

    config EXAMPLE_PORT
        int "Port"
        range 0 65535
        default 3333
        help
            Local port the example server will listen on.

    config EXAMPLE_KEEPALIVE_IDLE
        int "TCP keep-alive idle time(s)"
        default 5
        help
            Keep-alive idle time. In idle time without receiving any data from peer, will send keep-alive probe packet

    config EXAMPLE_KEEPALIVE_INTERVAL
        int "TCP keep-alive interval time(s)"
        default 5
        help
            Keep-alive probe packet interval time.

    config EXAMPLE_KEEPALIVE_COUNT
        int "TCP keep-alive packet retry send counts"
        default 3
        help
            Keep-alive probe packet retry count.
            
    config I2C_MASTER_SCL
        int "SCL GPIO Num"
        default 6 if IDF_TARGET_ESP32C3 || IDF_TARGET_ESP32C2 || IDF_TARGET_ESP32H2
        default 19 if IDF_TARGET_ESP32 || IDF_TARGET_ESP32S2 || IDF_TARGET_ESP32S3
        help
            GPIO number for I2C Master clock line.

    config I2C_MASTER_SDA
        int "SDA GPIO Num"
        default 5 if IDF_TARGET_ESP32C3 || IDF_TARGET_ESP32C2 || IDF_TARGET_ESP32H2
        default 18 if IDF_TARGET_ESP32 || IDF_TARGET_ESP32S2 || IDF_TARGET_ESP32S3
        help
            GPIO number for I2C Master data line.
endmenu
```
